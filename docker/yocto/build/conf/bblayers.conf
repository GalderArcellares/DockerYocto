## docker/yocto/build/conf/bblayers.conf
```bitbake
# POKY_BBLAYERS_CONF_VERSION is increased each time build/conf/bblayers.conf
# changes incompatibly
POKY_BBLAYERS_CONF_VERSION = "2"

BBPATH = "${TOPDIR}"
BBFILES ?= ""

BBLAYERS ?= " \
  /Yocto/poky/meta \
  /Yocto/poky/meta-poky \
  /Yocto/poky/meta-yocto-bsp \
  "
```
